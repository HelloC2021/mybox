/*
 * KC2 / K10Plus (海格森3528 遥控) 红外码表片段
 *
 * 用法: 合入 4.19 SDK 的 remotectl 节点 (compatible = "rockchip,remotectl-pwm")
 * 之下, 与原 ir_keyX 子节点并列。配合 patches/remotectl_mouse_4.19.patch:
 *
 *   驱动错位解码特性: 该遥控 NEC 地址 0x01 被解码为 usercode 0xFE01
 *   (与原装遥控器A 相同, 键值集合不相交, 可共存)
 *
 * 按键模式:
 *   F8 表见原厂 dts; 本表 12 键:
 *   电源=116 菜单=139 返回=158 HOME=102 音量+=115 音量-=114 确认=232(REPLY)
 *   方向=预留键值(按键模式下转 DPAD)
 * 鼠标模式 (按 0xFF 切换):
 *   方向=REL 光标移动  OK=BTN_MIDDLE 中键  返回=普通返回
 */

 ir_key_hgs3528: ir_key_hgs3528 {
         rockchip,usercode = <0xfe01>;
         rockchip,key_table =
                 <0xbf    116>,      /* power */
                 <0xb3    139>,      /* menu */
                 <0xe6    158>,      /* back */
                 <0xee    102>,      /* home */
                 <0xe7    115>,      /* volume+ */
                 <0xef    114>,      /* volume- */
                 <0xec    0x10c0>,   /* OK: key mode = KEY_REPLY / mouse mode = middle */
                 <0xe9    0x1011>,   /* up:   key mode = DPAD_UP  / mouse mode = cursor */
                 <0xe5    0x1012>,   /* down */
                 <0xae    0x1013>,   /* left */
                 <0xaf    0x1014>,   /* right */
                 <0xff    0x10f0>;   /* toggle mouse mode */
 };
